## app/ppr/Kconfig
```kconfig
#
# Copyright (c) 2026 Nordic Semiconductor ASA
#
# SPDX-License-Identifier: LicenseRef-Nordic-5-Clause
#

config PPR_HELLO
	bool "Enable periodic PPR hello world messages"
	default y
	help
	  Enable periodic "hello world" log messages from the PPR core.

if PPR_HELLO

config PPR_HELLO_INTERVAL_SECONDS
	int "Hello world interval (seconds)"
	default 60
	help
	  Interval between the "hello world" log messages printed by the PPR core.

endif # PPR_HELLO

source "Kconfig.zephyr"
```

## app/src/modules/power_monitor/Kconfig.power_monitor
```kconfig
#
# Copyright (c) 2026 Nordic Semiconductor ASA
#
# SPDX-License-Identifier: LicenseRef-Nordic-5-Clause
#

menuconfig APP_POWER_MONITOR
	bool "Power monitor module (INA228/INA238)"
	depends on DT_HAS_TI_INA228_ENABLED || DT_HAS_TI_INA237_ENABLED
	select SENSOR
	default y
	help
	  Reads a TI INA228 or INA238 power monitor (devicetree node label
	  "sip_power_monitor") on demand using the Zephyr sensor driver. The INA238 has no
	  Zephyr compatible of its own and is described as "ti,ina237", see
	  boards/ina238.overlay. Reports voltage, current and power. With an INA228, energy and
	  charge are also integrated by the hardware accumulators between readouts, and energy
	  and average current are reported through logs, shell commands and Memfault metrics.

if APP_POWER_MONITOR

config APP_POWER_MONITOR_ACCUMULATORS
	bool
	default y if DT_HAS_TI_INA228_ENABLED
	help
	  The power monitor has energy and charge accumulators (INA228). Not available on the
	  INA238.

config APP_POWER_MONITOR_MAX_READ_INTERVAL_HOURS
	int "Maximum time between readouts"
	default 10
	range 0 240
	depends on APP_POWER_MONITOR_ACCUMULATORS
	help
	  The INA228 is read when data is needed (shell command, Memfault heartbeat). If
	  nothing has read it for this many hours, a safety readout is done on the system
	  workqueue so that the hardware charge accumulator cannot overflow. With a 1 uA
	  current LSB it overflows after about 550000 C: about 11 days at the 546 mA full
	  scale of a 300 mOhm shunt. Set to 0 to disable the safety readout.

config APP_POWER_MONITOR_LOG_SAMPLES
	bool "Log every readout"
	default n
	help
	  Log voltage, current and power at every readout, and the average current since the
	  previous readout if the power monitor has accumulators.

config APP_POWER_MONITOR_SHELL
	bool "Power monitor shell commands"
	depends on SHELL
	default y

module = APP_POWER_MONITOR
module-str = Power monitor
source "subsys/logging/Kconfig.template.log_config"

endif # APP_POWER_MONITOR
```

## app/src/modules/ppr_launcher/Kconfig.ppr_launcher
```kconfig
#
# Copyright (c) 2026 Nordic Semiconductor ASA
#
# SPDX-License-Identifier: LicenseRef-Nordic-5-Clause
#

menu "PPR launcher"

config APP_PPR_LAUNCHER
	bool "Manual PPR launcher with shell control"
	depends on SOC_SERIES_NRF92
	depends on SHELL
	help
	  Replicate the load + cache-flush + cpurun_set sequence done by
	  drivers/misc/nordic_vpr_launcher, but expose it behind shell
	  commands `ppr start` / `ppr stop` / `ppr status` so the PPR can be
	  brought up at a chosen moment (e.g. after nrf_modem_lib_init()).

	  Add overlay-ppr-manual.overlay via EXTRA_DTC_OVERLAY_FILE (see overlay file header).
	  Do not set DTC_OVERLAY_FILE to this file only, or boards/<BOARD>.overlay is skipped
	  and the nRF9251 MRAM child node (mram_memory_0) is missing from the merged DTS.
	  It removes execution-memory and source-memory from &cpuppr_vpr so
	  CONFIG_NORDIC_VPR_LAUNCHER is disabled; otherwise the board DTS still supplies
	  those phandles and the PPR starts at POST_KERNEL before your shell runs.

if APP_PPR_LAUNCHER

config APP_PPR_LAUNCHER_LOG_LEVEL
	int "PPR launcher log level"
	default 4
	range 0 4

endif # APP_PPR_LAUNCHER

endmenu
```

## app/src/modules/pwm/Kconfig.pwm
```kconfig
#
# Copyright (c) 2026 Nordic Semiconductor
#
# SPDX-License-Identifier: LicenseRef-Nordic-5-Clause
#

menuconfig APP_PWM
	bool "PWM module"
	# The PPR image places the implementation next to a shadow of pwm_chan.
	select APP_ZBUS_PROXY if BOARD_NRF9251DK_NRF9251_CPUPPR
	select ZBUS if BOARD_NRF9251DK_NRF9251_CPUPPR
	select PWM if !APP_PWM_REMOTE
	help
	  Zbus controlled PWM output. The module is enabled in the application core image. The
	  core that runs the implementation is selected in sysbuild with SB_CONFIG_ATT_PWM_ON_PPR.

if APP_PWM

config APP_PWM_REMOTE
	bool "PWM implementation runs on the PPR core"
	depends on !BOARD_NRF9251DK_NRF9251_CPUPPR
	select APP_ZBUS_PROXY
	help
	  Set by sysbuild (SB_CONFIG_ATT_PWM_ON_PPR), do not set manually. The application core
	  then only owns pwm_chan and forwards it to the PPR core with the zbus proxy agent.

config APP_PWM_SHELL
	bool "PWM module shell"
	depends on !BOARD_NRF9251DK_NRF9251_CPUPPR
	default y if SHELL
	help
	  Enable shell for the PWM module. The shell always runs on the application core.

config APP_PWM_DEFAULT_PERIOD_USEC
	int "Default PWM period in microseconds"
	default 1000
	help
	  Period used by PWM_ON before a PWM_SET message has been received.

config APP_PWM_DEFAULT_PULSE_USEC
	int "Default PWM pulse width in microseconds"
	default 500
	help
	  Pulse width used by PWM_ON before a PWM_SET message has been received.

module = APP_PWM
module-str = PWM
source "subsys/logging/Kconfig.template.log_config"

endif # APP_PWM
```

## app/src/modules/saadc/Kconfig.saadc
```kconfig
#
# Copyright (c) 2026 Nordic Semiconductor
#
# SPDX-License-Identifier: LicenseRef-Nordic-5-Clause
#

menuconfig APP_SAADC
	bool "SAADC module"
	# The PPR image places the implementation next to a shadow of saadc_chan.
	select APP_ZBUS_PROXY if BOARD_NRF9251DK_NRF9251_CPUPPR
	select ZBUS if BOARD_NRF9251DK_NRF9251_CPUPPR
	select ADC if !APP_SAADC_REMOTE
	select SMF if !APP_SAADC_REMOTE
	select ZBUS_MSG_SUBSCRIBER if !APP_SAADC_REMOTE
	help
	  Zbus controlled SAADC sampling. The module is enabled in the application core image. The
	  core that runs the implementation is selected in sysbuild with SB_CONFIG_ATT_SAADC_ON_PPR.

if APP_SAADC

config APP_SAADC_REMOTE
	bool "SAADC implementation runs on the PPR core"
	depends on !BOARD_NRF9251DK_NRF9251_CPUPPR
	select APP_ZBUS_PROXY
	help
	  Set by sysbuild (SB_CONFIG_ATT_SAADC_ON_PPR), do not set manually. The application core
	  then only owns saadc_chan and forwards it to the PPR core with the zbus proxy agent, and
	  receives saadc_resp_chan from it.

config APP_SAADC_SHELL
	bool "SAADC module shell"
	depends on !BOARD_NRF9251DK_NRF9251_CPUPPR
	default y if SHELL
	help
	  Enable shell for the SAADC module. The shell always runs on the application core.

config APP_SAADC_SHELL_TIMEOUT_MS
	int "Shell wait time for a sample response in milliseconds"
	depends on APP_SAADC_SHELL
	default 3000

config APP_SAADC_THREAD_STACK_SIZE
	int "Thread stack size"
	depends on !APP_SAADC_REMOTE
	default 1024

config APP_SAADC_WATCHDOG_TIMEOUT_SECONDS
	int "Watchdog timeout"
	depends on !APP_SAADC_REMOTE && TASK_WDT
	default 120
	help
	  Timeout in seconds for the SAADC module watchdog.
	  The timeout given in this option covers both:
	    * Waiting for an incoming message in zbus_sub_wait_msg().
	    * Time spent processing the message, defined by
	      CONFIG_APP_SAADC_MSG_PROCESSING_TIMEOUT_SECONDS.
	  Ensure that this value exceeds CONFIG_APP_SAADC_MSG_PROCESSING_TIMEOUT_SECONDS.

config APP_SAADC_MSG_PROCESSING_TIMEOUT_SECONDS
	int "Maximum message processing time"
	depends on !APP_SAADC_REMOTE && TASK_WDT
	default 3
	help
	  Maximum time allowed for processing a single message in the module's state machine.
	  The value must be smaller than CONFIG_APP_SAADC_WATCHDOG_TIMEOUT_SECONDS.

module = APP_SAADC
module-str = SAADC
source "subsys/logging/Kconfig.template.log_config"

endif # APP_SAADC
```

## west.yml
```yaml
# Copyright (c) 2024 Nordic Semiconductor
# SPDX-License-Identifier: LicenseRef-Nordic-5-Clause

manifest:
  self:
    west-commands: scripts/west-commands.yml
    path: project

  remotes:
    - name: ncs
      url-base: https://github.com/nrfconnect
    - name: trondfc
      url-base: https://github.com/Trond-F-Christiansen

  projects:
    # Overrides the Memfault SDK imported from nrf: multi-component OTA PoC
    # (branch poc/keyless-component).
    - name: memfault-firmware-sdk
      remote: trondfc
      repo-path: memfault-firmware-sdk
      revision: 9238f1591f36e9a55a404bd91b4cc23347d25793
      path: modules/lib/memfault-firmware-sdk
    - name: nrf
      remote: trondfc
      repo-path: sdk-nrf
      revision: 90062c48e64969a8cffcc7394596aba4a586772d
      import: true
```
