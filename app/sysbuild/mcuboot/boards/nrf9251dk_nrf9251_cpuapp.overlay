/*
 * Copyright (c) 2026 Nordic Semiconductor ASA
 *
 * SPDX-License-Identifier: LicenseRef-Nordic-5-Clause
 */


#include "../../../boards/nrf9251dk_common.overlay"

/*
 * The board DTS points zephyr,code-partition at slot0 for the application. The
 * bootloader itself has to live in the dedicated boot partition, otherwise it is
 * linked on top of the image it is supposed to load.
 */
/ {
	chosen {
		zephyr,code-partition = &cpuapp_boot_partition;
	};

	/* Held at reset to enter serial recovery; MCUboot errors out without it. */
	aliases {
		mcuboot-button0 = &button1;
	};
};
