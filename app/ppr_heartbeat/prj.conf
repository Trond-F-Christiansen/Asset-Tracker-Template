## CMakeLists.txt
```
#
# Copyright (c) 2026 Nordic Semiconductor ASA
#
# SPDX-License-Identifier: LicenseRef-Nordic-5-Clause
#

cmake_minimum_required(VERSION 3.20.0)

# Same board root as the main ATT image so sysbuild child images resolve SHIELD=...
cmake_path(GET CMAKE_CURRENT_SOURCE_DIR PARENT_PATH _att_app_dir)
list(APPEND BOARD_ROOT "${_att_app_dir}")

find_package(Zephyr REQUIRED HINTS $ENV{ZEPHYR_BASE})
project(att_ppr_heartbeat)

target_sources(app PRIVATE src/main.c)
```

## Kconfig
```
# Copyright (c) 2026 Nordic Semiconductor ASA
# SPDX-License-Identifier: LicenseRef-Nordic-5-Clause

mainmenu "PPR heartbeat triage"
```

## prj.conf
```kconfig
CONFIG_CONSOLE=y
CONFIG_UART_CONSOLE=y
CONFIG_USE_DT_CODE_PARTITION=y
CONFIG_XIP=n
```

## boards/nrf9251dk_nrf9251_cpuppr.overlay
```dts
/*
 * Copyright (c) 2026 Nordic Semiconductor ASA
 *
 * SPDX-License-Identifier: LicenseRef-Nordic-5-Clause
 */

 #include <common/nordic/nrf9251dk_nrf9251-pinctrl.dtsi>

/ {
	chosen {
		zephyr,console = &uart133;
	};
};



&uart132 {
	status = "disabled";
};

 /*
&zephyr_i2c: &i2c120 {
	compatible = "nordic,nrf-twim";
	status = "disabled";
	clock-frequency = <I2C_BITRATE_STANDARD>;

	pinctrl-0 = <&i2c120_default>;
	pinctrl-1 = <&i2c120_sleep>;
	pinctrl-names = "default", "sleep";

	bme680: bme680@76 {
		status = "disabled";
		compatible = "bosch,bme680";
		reg = <0x76>;
	};

*/
```

## src/main.c
```c
/*
 * Copyright (c) 2026 Nordic Semiconductor ASA
 *
 * SPDX-License-Identifier: LicenseRef-Nordic-5-Clause
 */

#include <zephyr/kernel.h>
#include <zephyr/sys/printk.h>

int main(void)
{
	uint32_t iter = 0;

	while (1) {
		if (iter == 0) {
			printk("att_ppr_heartbeat: alive\n");
		}

		printk("att_ppr_heartbeat: uptime: %llu ms\n", k_uptime_get());

		iter++;

		k_sleep(K_SECONDS(1));
	}

	return 0;
}
```
