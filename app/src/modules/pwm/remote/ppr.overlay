/*
 * Copyright (c) 2026 Nordic Semiconductor ASA
 *
 * SPDX-License-Identifier: LicenseRef-Nordic-5-Clause
 */

/* PWM output on P2.2 (same pin as led0 on the nRF9251 DK). The pinctrl nodes are defined in
 * the board's pinctrl file, which is shared with the application core.
 */

/ {
	zephyr,user {
		pwms = <&pwm130 0 PWM_MSEC(20) PWM_POLARITY_NORMAL>;
	};
};

&pwm130 {
	status = "okay";
	pinctrl-0 = <&pwm130_default>;
	pinctrl-1 = <&pwm130_sleep>;
	pinctrl-names = "default", "sleep";
	memory-regions = <&cpuppr_dma_region>;
};
